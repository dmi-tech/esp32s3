## CMakeLists.txt
```
cmake_minimum_required(VERSION 3.20.0)
find_package(Zephyr REQUIRED HINTS $ENV{ZEPHYR_BASE})
project(line_follower_logic_test C)

set(app_dir ${CMAKE_CURRENT_SOURCE_DIR}/../..)

target_include_directories(app PRIVATE ${app_dir}/src src)

# Mã thật của firmware; phần cứng được thay bằng src/fakes.c
target_sources(app PRIVATE
  ${app_dir}/src/clock_format.c
  ${app_dir}/src/destination_manager.c
  ${app_dir}/src/drive.c
  ${app_dir}/src/events.c
  ${app_dir}/src/json_flat.c
  ${app_dir}/src/line_pid.c
  ${app_dir}/src/obstacle_filter.c
  ${app_dir}/src/path_control.c
  ${app_dir}/src/robot_logic.c
  ${app_dir}/src/robot_state.c
  ${app_dir}/src/route.c
  ${app_dir}/src/wav.c
  ${app_dir}/src/web_protocol.c
  src/fakes.c
  src/test_parsers.c
  src/test_robot.c
  src/test_web.c
)

generate_inc_file_for_target(app ${app_dir}/assets/audio/welcome.wav
  ${ZEPHYR_BINARY_DIR}/include/generated/welcome.wav.inc)
```

## prj.conf
```kconfig
CONFIG_ZTEST=y
CONFIG_LOG=y
CONFIG_REQUIRES_FULL_LIBC=y
CONFIG_CBPRINTF_FP_SUPPORT=y
CONFIG_ZTEST_STACK_SIZE=8192
# Tắt log của parser khi chạy 40000 đầu vào rác
CONFIG_LOG_DEFAULT_LEVEL=1
CONFIG_LOG_OVERRIDE_LEVEL=1
```

## src/fakes.c
```c
#include <errno.h>
#include <string.h>

#include <zephyr/kernel.h>

#include "audio.h"
#include "destination_manager.h"
#include "events.h"
#include "fakes.h"
#include "motor_control.h"
#include "robot_logic.h"

struct fake_hw fake;

void motor_output(int left, int right)
{
	fake.left = left;
	fake.right = right;
}

void stop_motors(void)
{
	fake.left = 0;
	fake.right = 0;
}

void audio_request(const char *file)
{
	fake.audio_requests++;
	robot_copy_text(fake.audio_file, sizeof(fake.audio_file), file);
}

int tables_storage_read(char *buf, size_t size)
{
	if (fake.file_len < 0) {
		return -ENOENT;
	}
	if ((size_t)fake.file_len > size) {
		return -EFBIG;
	}
	memcpy(buf, fake.file, fake.file_len);
	return fake.file_len;
}

int tables_storage_write(const char *data, size_t len)
{
	if (fake.fail_write || len > sizeof(fake.file)) {
		return -EIO;
	}
	memcpy(fake.file, data, len);
	fake.file_len = (int)len;
	return 0;
}

void fake_reset(void)
{
	static struct robot_state defaults;
	static bool saved;
	char message[EVENT_MESSAGE_LEN];

	if (!saved) {
		defaults = g_robot;
		saved = true;
	}

	g_robot = defaults;
	memset(&fake, 0, sizeof(fake));
	fake.file_len = -1;
	k_msgq_purge(&g_cmd_queue);
	while (event_take(message)) {
	}
	(void)event_take_config_request();
	robot_logic_reset();
	(void)destinations_init("{}");
}

bool event_seen(const char *needle)
{
	char message[EVENT_MESSAGE_LEN];
	bool seen = false;

	while (event_take(message)) {
		seen = seen || strstr(message, needle) != NULL;
	}

	return seen;
}
```

## src/fakes.h
```c
#pragma once

#include <stdbool.h>
#include <stddef.h>

#include "robot_state.h"

struct fake_hw {
	int left; /* đầu ra motor hiện tại */
	int right;
	int audio_requests;
	char audio_file[80];
	char file[4096]; /* tables.json trong RAM */
	int file_len;    /* < 0: chưa có file */
	bool fail_write;
};

extern struct fake_hw fake;

/* Đưa trạng thái robot, hàng đợi, logic và phần cứng giả về ban đầu */
void fake_reset(void);

/* true nếu từ lần fake_reset có sự kiện chứa chuỗi này (đọc hết hàng đợi) */
bool event_seen(const char *needle);
```

## src/test_parsers.c
```c
/* PID, mã tuyến, bảng điểm đến, JSON, vật cản, WAV, đồng hồ */

#include <string.h>

#include <zephyr/ztest.h>

#include "clock_format.h"
#include "destination_manager.h"
#include "fakes.h"
#include "json_flat.h"
#include "line_pid.h"
#include "obstacle_filter.h"
#include "wav.h"

static void before(void *fixture)
{
	ARG_UNUSED(fixture);
	fake_reset();
}

ZTEST_SUITE(parsers, NULL, NULL, before, NULL, NULL);

ZTEST(parsers, test_line_position)
{
	const uint8_t center[5] = {0, 0, 1, 0, 0};
	const uint8_t left[5] = {1, 1, 0, 0, 0};
	const uint8_t right[5] = {0, 0, 0, 0, 1};
	const uint8_t none[5] = {0};

	zassert_within(line_position(center, 9.0f), 0.0f, 1e-6f);
	zassert_within(line_position(left, 0.0f), -1.5f, 1e-6f);
	zassert_within(line_position(right, 0.0f), 2.0f, 1e-6f);
	/* Mất line: giữ sai số trước đó */
	zassert_within(line_position(none, -1.5f), -1.5f, 1e-6f);
}

ZTEST(parsers, test_pid)
{
	g_robot.ki = 1.0f;
	pid_reset(&g_robot, 1000);

	/* dt = 0,01 s: P = 35, I = 0,01, D = 20 * 1 / 0,01 */
	zassert_within(pid_calculate(&g_robot, 1.0f, 1010), 35.0f + 0.01f + 2000.0f, 0.01f);
	/* Cùng thời điểm: dt bị thay bằng 1 ms, đạo hàm 0 */
	zassert_within(pid_calculate(&g_robot, 1.0f, 1010), 35.0f + 0.011f, 0.01f);
	/* Tích phân bị kẹp ở 10 */
	(void)pid_calculate(&g_robot, 2.0f, 61010);
	zassert_within(g_robot.integral, 10.0f, 1e-5f);
}

ZTEST(parsers, test_manual_drive)
{
	int l;
	int r;

	manual_drive_speeds("forward_left", 150, 255, &l, &r);
	zassert_equal(l, 75);
	zassert_equal(r, 150);
	manual_drive_speeds("back_right", 999, 255, &l, &r);
	zassert_equal(l, -255);
	zassert_equal(r, -127);
	manual_drive_speeds("forward", -5, 255, &l, &r);
	zassert_equal(l, 0);
	manual_drive_speeds("jump", 150, 255, &l, &r);
	zassert_equal(l, 0);
	zassert_equal(r, 0);
}

ZTEST(parsers, test_route_validation)
{
	const char *error = NULL;
	char longest[92];

	zassert_true(route_path_valid("0", &error));
	zassert_true(route_path_valid("LRLSLR0", &error));

	memset(longest, 'S', sizeof(longest));
	longest[89] = '0';
	longest[90] = '\0';
	zassert_true(route_path_valid(longest, &error));
	longest[89] = 'S';
	longest[90] = '0';
	longest[91] = '\0';
	zassert_false(route_path_valid(longest, &error));
	zassert_str_equal(error, "code too long");

	zassert_false(route_path_valid("", &error));
	zassert_str_equal(error, "empty code");
	zassert_false(route_path_valid("LR", &error));
	zassert_str_equal(error, "code must end with 0");
	zassert_false(route_path_valid("L0R0", &error));
	zassert_str_equal(error, "0 only allowed at the end");
	zassert_false(route_path_valid("lr0", &error));
	zassert_str_equal(error, "only L R S 0 allowed");
}

static void expect_save_error(const char *body, const char *expected)
{
	const char *error = NULL;

	zassert_not_equal(destinations_save_json(body, strlen(body), &error), 0, "%s", body);
	zassert_str_equal(error, expected, "%s", body);
}

ZTEST(parsers, test_tables_save_and_errors)
{
	const char *good = " { \"3\" : \"LR0\", \"1\":\"S0\" } ";
	const char *error = NULL;
	char json[DESTINATION_JSON_LEN];
	char code[ROUTE_CODE_MAX_LEN + 1];

	zassert_ok(destinations_save_json(good, strlen(good), &error));
	zassert_true(destinations_json(json, sizeof(json)) > 0);
	zassert_str_equal(json, "{\"1\":\"S0\",\"3\":\"LR0\"}");

	expect_save_error("", "EmptyInput");
	expect_save_error("{\"1\":\"S0\"", "IncompleteInput");
	expect_save_error("{\"1\" \"S0\"}", "InvalidInput");
	expect_save_error("{\"1\":\"S0\"} x", "InvalidInput");
	expect_save_error("[1]", "root must be object");
	expect_save_error("{\"a\":\"S0\"}", "id must be an integer from 1 to 2147483647");
	expect_save_error("{\"0\":\"S0\"}", "id must be an integer from 1 to 2147483647");
	expect_save_error("{\"2147483648\":\"S0\"}",
			  "id must be an integer from 1 to 2147483647");
	expect_save_error("{\"1\":\"S0\",\"01\":\"L0\"}", "duplicate destination id");
	expect_save_error("{\"1\":5}", "code must be string");
	expect_save_error("{\"1\":\"X0\"}", "only L R S 0 allowed");

	/* Lỗi nào cũng giữ bảng cũ */
	zassert_true(destinations_lookup(3, code));
	zassert_str_equal(code, "LR0");

	fake.fail_write = true;
	expect_save_error("{\"9\":\"S0\"}", "cannot write tables.json");
	zassert_false(destinations_lookup(9, code));
}

ZTEST(parsers, test_tables_limit)
{
	static char body[1024];
	const char *error = NULL;
	int n = 0;

	for (int i = 1; i <= DESTINATION_MAX + 1; i++) {
		n += snprintk(&body[n], sizeof(body) - n, "%c\"%d\":\"S0\"",
			      i == 1 ? '{' : ',', i);
	}
	body[n++] = '}';

	zassert_not_equal(destinations_save_json(body, n, &error), 0);
	zassert_str_equal(error, "too many destinations (max 32)");
}

ZTEST(parsers, test_tables_load)
{
	char json[DESTINATION_JSON_LEN];
	const char *stored = "{\"2\":\"L0\",\"x\":\"S0\",\"4\":\"bad\",\"5\":7}";

	/* Chưa có file: ghi và nạp bảng mặc định */
	fake.file_len = -1;
	zassert_ok(destinations_init("{\"1\":\"S0\"}"));
	zassert_true(fake.file_len > 0);

	/* Nạp file: bỏ qua mục hỏng */
	zassert_ok(tables_storage_write(stored, strlen(stored)));
	zassert_ok(destinations_load());
	(void)destinations_json(json, sizeof(json));
	zassert_str_equal(json, "{\"2\":\"L0\"}");

	/* File hỏng: giữ bảng đang có */
	zassert_ok(tables_storage_write("{oops", 5));
	zassert_not_equal(destinations_load(), 0);
	(void)destinations_json(json, sizeof(json));
	zassert_str_equal(json, "{\"2\":\"L0\"}");
}

ZTEST(parsers, test_json_syntax)
{
	const char *nested = "{\"a\":{\"b\":[1,{\"c\":null}],\"d\":-1.5e3},\"e\":true}";
	const char *deep = "{\"a\":[[[[[[[[[[1]]]]]]]]]]}";
	const char *bad[] = {"{\"a\":01}", "{\"a\":1,}", "{,}", "{\"a\":[1,]}",
			     "{\"a\":\"\\x\"}", "{\"a\":tru}", "{a:1}"};

	zassert_equal(json_flat_parse(nested, strlen(nested), NULL, NULL), JSON_FLAT_OK);
	zassert_equal(json_flat_parse(deep, strlen(deep), NULL, NULL), JSON_FLAT_TOO_DEEP);

	for (size_t i = 0; i < ARRAY_SIZE(bad); i++) {
		zassert_not_equal(json_flat_parse(bad[i], strlen(bad[i]), NULL, NULL),
				  JSON_FLAT_OK, "%s", bad[i]);
	}

	/* Cắt ở bất kỳ vị trí nào cũng không được coi là hợp lệ */
	for (size_t len = 0; len < strlen(nested); len++) {
		zassert_not_equal(json_flat_parse(nested, len, NULL, NULL), JSON_FLAT_OK,
				  "len %u", (unsigned int)len);
	}
}

ZTEST(parsers, test_json_strings)
{
	const char *raw = "A\\u00e9\\n\\\"";
	const struct json_flat_value value = {
		.type = JSON_FLAT_STRING, .raw = raw, .raw_len = strlen(raw)};
	char out[16];
	char tiny[3];

	zassert_true(json_flat_get_string(&value, out, sizeof(out)));
	zassert_str_equal(out, "A\xc3\xa9\n\"");
	zassert_false(json_flat_get_string(&value, tiny, sizeof(tiny)));

	json_flat_escape(out, sizeof(out), "a\"b\\c\n");
	zassert_str_equal(out, "a\\\"b\\\\c\\u000a");
}

/* Độ rộng xung (us) tương ứng một khoảng cách */
static uint32_t pulse_for(float cm)
{
	return (uint32_t)(cm * 2.0f / 0.0343f);
}

ZTEST(parsers, test_obstacle_hysteresis)
{
	struct obstacle_filter f = {0};

	obstacle_filter_echo(&f, pulse_for(12.0f));
	zassert_false(f.detected);
	obstacle_filter_echo(&f, pulse_for(8.0f));
	zassert_true(f.detected);
	obstacle_filter_echo(&f, pulse_for(12.0f));
	zassert_true(f.detected, "vẫn dưới ngưỡng xoá 15 cm");
	obstacle_filter_echo(&f, pulse_for(16.0f));
	zassert_false(f.detected);

	obstacle_filter_echo(&f, pulse_for(5.0f));
	obstacle_filter_no_echo(&f);
	zassert_true(f.detected);
	obstacle_filter_echo(&f, pulse_for(5.0f)); /* đếm lại từ đầu */
	obstacle_filter_no_echo(&f);
	zassert_true(f.detected);
	obstacle_filter_echo(&f, pulse_for(500.0f)); /* ngoài tầm = không echo */
	zassert_false(f.detected);

	/* Không echo không bao giờ tự bật trạng thái vật cản */
	obstacle_filter_no_echo(&f);
	obstacle_filter_no_echo(&f);
	zassert_false(f.detected);
}

ZTEST(parsers, test_wav)
{
	static const uint8_t file[] = {
#include "welcome.wav.inc"
	};
	struct wav_pcm pcm;
	uint8_t broken[64];

	zassert_ok(wav_parse(file, sizeof(file), &pcm));
	zassert_equal(pcm.sample_rate, 16000);
	zassert_true(pcm.bytes > 16000 && pcm.bytes < sizeof(file));

	zassert_not_equal(wav_parse(file, 20, &pcm), 0);
	/* Cắt giữa chunk data (file có chunk phụ nằm sau data) */
	zassert_not_equal(wav_parse(file, sizeof(file) / 2, &pcm), 0);
	memcpy(broken, file, sizeof(broken));
	broken[22] = 2; /* stereo */
	zassert_not_equal(wav_parse(broken, sizeof(broken), &pcm), 0);
}

ZTEST(parsers, test_clock_text)
{
	char text[CLOCK_TEXT_LEN];
	const int64_t t = 5 * 86400 + 13 * 3600 + 7 * 60;

	clock_format(false, t, text);
	zassert_str_equal(text, "----");
	clock_format(true, t, text);
	zassert_str_equal(text, "13.07");
	clock_format(true, t + 1, text);
	zassert_str_equal(text, "1307");
}
```

## src/test_robot.c
```c
/*
 * Vòng điều khiển và máy trạng thái ngã rẽ. Thời gian giả, mỗi bước 5 ms
 * như LINE_LOOP_DELAY_MS.
 */

#include <string.h>

#include <zephyr/ztest.h>

#include "fakes.h"
#include "robot_logic.h"

static const uint8_t CENTER[5] = {0, 0, 1, 0, 0};
static const uint8_t JUNCTION[5] = {1, 1, 1, 1, 1};
static const uint8_t SIDES[5] = {1, 0, 0, 0, 1};
static const uint8_t NONE[5] = {0, 0, 0, 0, 0};
static const uint8_t LEFT_ONLY[5] = {1, 0, 0, 0, 0};
static const uint8_t SLIGHT_RIGHT[5] = {0, 0, 0, 1, 0};

static uint32_t now;

static void run(const uint8_t sensor[5], uint32_t duration_ms)
{
	for (uint32_t t = 0; t < duration_ms; t += LINE_LOOP_DELAY_MS) {
		now += LINE_LOOP_DELAY_MS;
		robot_logic_step(now, sensor);
	}
}

static void send(uint8_t type, const char *text, int value)
{
	struct command c = {.type = type, .value = value};

	robot_copy_text(c.text, sizeof(c.text), text);
	zassert_ok(k_msgq_put(&g_cmd_queue, &c, K_NO_WAIT));
}

static void start_route(const char *code)
{
	send(CMD_GOTO, code, 1);
	run(CENTER, CENTER_ARM_MS + 20);
	zassert_true(g_robot.junction_armed);
}

/* Đi qua ngã rẽ cho tới khi được xác nhận */
static void hit_junction(void)
{
	run(JUNCTION, JUNCTION_STABLE_MS + 10);
}

static void before(void *fixture)
{
	ARG_UNUSED(fixture);
	fake_reset();
	now = 10000;
}

ZTEST_SUITE(robot, NULL, NULL, before, NULL, NULL);

ZTEST(robot, test_stop_mode_keeps_motors_off)
{
	run(CENTER, 100);
	zassert_equal(fake.left, 0);
	zassert_equal(fake.right, 0);
}

ZTEST(robot, test_auto_follows_line)
{
	send(CMD_START, "", 0);
	run(CENTER, 50);
	zassert_equal(g_robot.mode, MODE_AUTO);
	zassert_equal(fake.left, 150);
	zassert_equal(fake.right, 150);

	/* Ổn định ở sai số +1: correction = 35 */
	run(SLIGHT_RIGHT, 50);
	zassert_equal(fake.left, 115);
	zassert_equal(fake.right, 185);
}

ZTEST(robot, test_outer_sensor_only_keeps_previous_output)
{
	send(CMD_START, "", 0);
	run(CENTER, 50);
	run(LEFT_ONLY, 50);
	zassert_equal(fake.left, 150);
	zassert_equal(fake.right, 150);
}

ZTEST(robot, test_lost_line_keeps_driving_like_original)
{
	send(CMD_START, "", 0);
	run(SLIGHT_RIGHT, 50);
	run(NONE, 500);
	zassert_equal(g_robot.mode, MODE_AUTO);
	zassert_equal(fake.left, 115);
	zassert_equal(fake.right, 185);
}

ZTEST(robot, test_manual_drive_times_out)
{
	send(CMD_DRIVE, "forward", 0);
	run(CENTER, DRIVE_TIMEOUT);
	zassert_equal(fake.left, 150);
	run(CENTER, 20);
	zassert_equal(fake.left, 0);
	zassert_equal(fake.right, 0);

	send(CMD_DRIVE, "back", 0);
	run(CENTER, 10);
	zassert_equal(fake.left, -150);
	send(CMD_DRIVE, "stop", 0);
	run(CENTER, 10);
	zassert_equal(g_robot.mode, MODE_STOP);
	zassert_equal(fake.left, 0);
}

ZTEST(robot, test_estop_stops_immediately)
{
	send(CMD_START, "", 0);
	run(CENTER, 50);
	send(CMD_ESTOP, "", 0);
	run(CENTER, 5);
	zassert_equal(g_robot.mode, MODE_STOP);
	zassert_false(g_robot.enabled);
	zassert_equal(fake.left, 0);
	zassert_str_equal(g_robot.notice, "E-STOP");
}

ZTEST(robot, test_junction_needs_arming)
{
	send(CMD_GOTO, "L0", 1);
	run(JUNCTION, 200);
	zassert_equal(g_robot.path_idx, 0);
}

ZTEST(robot, test_junction_approach_slows_to_half)
{
	start_route("S0");
	zassert_equal(fake.left, 150);
	run(JUNCTION, 10);
	zassert_equal(fake.left, 75);
	zassert_equal(fake.right, 75);
	zassert_equal(g_robot.path_idx, 0);
}

ZTEST(robot, test_junction_glitch_is_ignored)
{
	start_route("L0");
	run(JUNCTION, JUNCTION_STABLE_MS - 10);
	run(CENTER, 20);
	zassert_equal(g_robot.path_idx, 0);
	zassert_equal(fake.left, 150);
}

ZTEST(robot, test_straight_action)
{
	start_route("S0");
	hit_junction();
	zassert_equal(g_robot.path_idx, 1);
	zassert_equal(fake.left, 0);

	run(JUNCTION, JUNCTION_STOP_MS - 20);
	zassert_equal(fake.left, 0, "vẫn đang dừng 2 s");
	run(JUNCTION, 40);
	zassert_equal(fake.left, 150);
	zassert_equal(fake.right, 150);
	run(JUNCTION, ROUTE_ACTION_MS);
	zassert_true(event_seen("ACTION COMPLETE"));
	zassert_false(g_robot.junction_armed);
	zassert_equal(g_robot.mode, MODE_PATH);
}

ZTEST(robot, test_left_turn_waits_for_center_three_phases)
{
	start_route("L0");
	hit_junction();
	run(JUNCTION, JUNCTION_STOP_MS);

	run(CENTER, 50); /* S3 trên line */
	zassert_equal(fake.left, 0);
	zassert_equal(fake.right, 150);
	run(NONE, 100); /* rời line */
	zassert_equal(g_robot.turn, -1);
	run(CENTER, 50); /* bắt lại */
	zassert_true(event_seen("turn complete"));
	zassert_equal(g_robot.turn, 0);
	zassert_equal(g_robot.mode, MODE_PATH);
}

ZTEST(robot, test_right_turn_drives_left_wheel)
{
	start_route("R0");
	hit_junction();
	run(JUNCTION, JUNCTION_STOP_MS);
	run(NONE, 20);
	zassert_equal(fake.left, 150);
	zassert_equal(fake.right, 0);
}

ZTEST(robot, test_turn_timeout_stops_robot)
{
	start_route("R0");
	hit_junction();
	run(JUNCTION, JUNCTION_STOP_MS);
	run(NONE, ROUTE_TURN_TIMEOUT_MS + 20);
	zassert_equal(g_robot.mode, MODE_STOP);
	zassert_false(g_robot.enabled);
	zassert_equal(fake.left, 0);
	zassert_equal(fake.right, 0);
	zassert_true(event_seen("TURN TIMEOUT"));
	run(CENTER, 100);
	zassert_equal(fake.left, 0);
}

ZTEST(robot, test_destination_reached)
{
	start_route("0");
	hit_junction();
	zassert_equal(g_robot.mode, MODE_STOP);
	zassert_equal(fake.left, 0);
	zassert_equal(fake.audio_requests, 1);
	zassert_str_equal(fake.audio_file, "welcome.mp3");
	zassert_str_equal(g_robot.notice, "ARRIVED dest=1 (destination)");
}

ZTEST(robot, test_full_route)
{
	start_route("S0");
	hit_junction();
	run(JUNCTION, JUNCTION_STOP_MS + ROUTE_ACTION_MS + 20);
	run(CENTER, CENTER_ARM_MS + 20);
	run(SIDES, JUNCTION_STABLE_MS + 10);
	zassert_equal(g_robot.mode, MODE_STOP);
	zassert_equal(fake.audio_requests, 1);
}

ZTEST(robot, test_obstacle_stops_and_extends_action)
{
	start_route("S0");
	hit_junction();
	run(JUNCTION, JUNCTION_STOP_MS + 100); /* đang chạy thẳng */
	zassert_equal(fake.left, 150);

	g_robot.obstacle_detected = true;
	g_robot.obstacle_distance_cm = 5.0f;
	run(JUNCTION, 3000);
	zassert_equal(fake.left, 0);
	zassert_equal(fake.right, 0);
	zassert_str_equal(g_robot.notice, "OBSTACLE 5.0 cm");

	g_robot.obstacle_detected = false;
	run(JUNCTION, 100);
	zassert_equal(fake.left, 150, "thời gian tạm dừng không được tính");
	zassert_false(event_seen("ACTION COMPLETE"));
	run(JUNCTION, ROUTE_ACTION_MS);
	zassert_true(event_seen("ACTION COMPLETE"));
}

ZTEST(robot, test_obstacle_blocks_every_mode)
{
	g_robot.obstacle_detected = true;
	send(CMD_DRIVE, "forward", 0);
	run(CENTER, 50);
	zassert_equal(fake.left, 0);
	send(CMD_START, "", 0);
	run(CENTER, 50);
	zassert_equal(fake.left, 0);
}

ZTEST(robot, test_new_command_cancels_junction_action)
{
	start_route("L0");
	hit_junction();
	send(CMD_START, "", 0);
	run(CENTER, 10);
	zassert_equal(g_robot.mode, MODE_AUTO);
	zassert_equal(fake.left, 150);
	zassert_equal(g_robot.turn, 0);
}

ZTEST(robot, test_fail_stop)
{
	send(CMD_START, "", 0);
	run(CENTER, 50);
	robot_fail_stop("line sensor read failed");
	zassert_equal(g_robot.mode, MODE_STOP);
	zassert_equal(fake.left, 0);
}
```

## src/test_web.c
```c
/* Giao thức WebSocket: phải khớp web_control.cpp bản cũ */

#include <stdlib.h>
#include <string.h>

#include <zephyr/ztest.h>

#include "destination_manager.h"
#include "events.h"
#include "fakes.h"
#include "web_protocol.h"

static void before(void *fixture)
{
	ARG_UNUSED(fixture);
	fake_reset();
}

ZTEST_SUITE(web, NULL, NULL, before, NULL, NULL);

static struct web_reply handle(const char *json)
{
	struct web_reply reply;

	web_handle_command(json, strlen(json), &reply);
	return reply;
}

static struct command expect_command(uint8_t type)
{
	struct command c;

	zassert_ok(k_msgq_get(&g_cmd_queue, &c, K_NO_WAIT));
	zassert_equal(c.type, type);
	return c;
}

static void expect_no_command(void)
{
	zassert_equal(k_msgq_num_used_get(&g_cmd_queue), 0);
}

ZTEST(web, test_simple_commands)
{
	struct command c;

	(void)handle("{\"cmd\":\"start\"}");
	(void)expect_command(CMD_START);
	(void)handle("{\"cmd\":\"estop\"}");
	(void)expect_command(CMD_ESTOP);
	(void)handle("{\"cmd\":\"drive\",\"dir\":\"left\"}");
	c = expect_command(CMD_DRIVE);
	zassert_str_equal(c.text, "left");
	(void)handle("{\"cmd\":\"drive\"}");
	c = expect_command(CMD_DRIVE);
	zassert_str_equal(c.text, "stop");
	(void)handle("{\"cmd\":\"play\"}");
	c = expect_command(CMD_PLAY);
	zassert_str_equal(c.text, "welcome.mp3");

	/* Lệnh không đổi trạng thái trực tiếp */
	zassert_equal(g_robot.mode, MODE_STOP);
}

ZTEST(web, test_ignores_bad_input)
{
	(void)handle("not json");
	(void)handle("{\"cmd\":\"fly\"}");
	(void)handle("{\"dir\":\"forward\"}");
	(void)handle("{\"cmd\":5}");
	(void)handle("");
	expect_no_command();
}

ZTEST(web, test_config_keeps_missing_fields)
{
	struct command c;

	(void)handle("{\"cmd\":\"config\",\"kp\":12.5,\"kd\":\"x\",\"base\":99.5}");
	c = expect_command(CMD_CONFIG);
	zassert_within(c.kp, 12.5f, 1e-6f);
	zassert_within(c.ki, 0.0f, 1e-6f);
	zassert_within(c.kd, 20.0f, 1e-6f);
	zassert_equal(c.base, 150);
}

static void expect_goto_rejected(const char *json, const char *reason)
{
	const struct web_reply r = handle(json);

	zassert_true(r.send_goto_result, "%s", json);
	zassert_false(r.ok, "%s", json);
	zassert_str_equal(r.message, reason, "%s", json);
	zassert_str_equal(g_robot.notice, reason);
	expect_no_command();
}

ZTEST(web, test_goto_validation)
{
	expect_goto_rejected("{\"cmd\":\"goto\"}", "Invalid destination ID");
	expect_goto_rejected("{\"cmd\":\"goto\",\"id\":\"1\"}", "Invalid destination ID");
	expect_goto_rejected("{\"cmd\":\"goto\",\"id\":1.5}", "Invalid destination ID");
	expect_goto_rejected("{\"cmd\":\"goto\",\"id\":0}", "Invalid destination ID");
	expect_goto_rejected("{\"cmd\":\"goto\",\"id\":7}",
			     "Destination not found; save or send a valid route");
	expect_goto_rejected("{\"cmd\":\"goto\",\"id\":7,\"code\":\"\"}",
			     "Destination not found; save or send a valid route");
	expect_goto_rejected("{\"cmd\":\"goto\",\"id\":7,\"code\":\"LR\"}",
			     "code must end with 0");
}

ZTEST(web, test_goto_with_code_and_table)
{
	const char *table = "{\"4\":\"RSR0\"}";
	const char *error = NULL;
	struct web_reply r;
	struct command c;

	r = handle("{\"cmd\":\"goto\",\"id\":2,\"code\":\"L0\"}");
	zassert_true(r.ok);
	zassert_str_equal(r.message, "Route 2 (L0) queued");
	c = expect_command(CMD_GOTO);
	zassert_equal(c.value, 2);
	zassert_str_equal(c.text, "L0");

	zassert_ok(destinations_save_json(table, strlen(table), &error));
	r = handle("{\"cmd\":\"goto\",\"id\":4}");
	zassert_true(r.ok);
	c = expect_command(CMD_GOTO);
	zassert_str_equal(c.text, "RSR0");
}

ZTEST(web, test_full_queue)
{
	struct web_reply r;

	for (int i = 0; i < COMMAND_QUEUE_LEN; i++) {
		(void)handle("{\"cmd\":\"start\"}");
	}

	r = handle("{\"cmd\":\"goto\",\"id\":2,\"code\":\"L0\"}");
	zassert_false(r.ok);
	zassert_str_equal(r.message, "Robot command queue is full");
	zassert_str_equal(g_robot.notice, "Command queue full; route was not started");

	/* E-STOP vẫn phải tới được luồng điều khiển */
	(void)handle("{\"cmd\":\"estop\"}");
	zassert_equal(k_msgq_num_used_get(&g_cmd_queue), 1);
	(void)expect_command(CMD_ESTOP);
}

ZTEST(web, test_tables_reload)
{
	char code[ROUTE_CODE_MAX_LEN + 1];

	zassert_ok(tables_storage_write("{\"8\":\"S0\"}", 10));
	(void)handle("{\"cmd\":\"tables_reload\"}");
	zassert_true(destinations_lookup(8, code));
	zassert_str_equal(g_robot.notice, "Tables reloaded");
	zassert_true(event_take_config_request());
	expect_no_command();
}

ZTEST(web, test_json_output)
{
	char buf[768];

	zassert_true(web_config_json(buf, sizeof(buf), &g_robot) > 0);
	zassert_str_equal(buf, "{\"type\":\"config\",\"kp\":35.000,\"ki\":0.000,"
			       "\"kd\":20.000,\"base\":150,\"max\":255,\"on\":false,"
			       "\"mode\":\"stop\",\"dest\":0,\"dir\":\"stop\"}");

	g_robot.sensor[2] = 1;
	g_robot.error = -1.5f;
	robot_set_notice("say \"hi\"");
	zassert_true(web_telemetry_json(buf, sizeof(buf), &g_robot, "10.0.0.2", -40) > 0);
	zassert_str_equal(buf, "{\"type\":\"telemetry\",\"s\":[0,0,1,0,0],\"err\":-1.50,"
			       "\"pid\":0.00,\"l\":0,\"r\":0,\"full\":false,\"on\":false,"
			       "\"mode\":\"stop\",\"dir\":\"stop\",\"dest\":0,\"step\":0,"
			       "\"notice\":\"say \\\"hi\\\"\",\"rssi\":-40,"
			       "\"ip\":\"10.0.0.2\"}");

	zassert_true(web_event_json(buf, sizeof(buf), "[X] y") > 0);
	zassert_str_equal(buf, "{\"type\":\"event\",\"message\":\"[X] y\"}");
	zassert_true(web_goto_result_json(buf, sizeof(buf), true, "ok") > 0);
	zassert_str_equal(buf, "{\"type\":\"command_result\",\"cmd\":\"goto\",\"ok\":true,"
			       "\"message\":\"ok\"}");
	zassert_true(web_event_json(buf, 10, "x") < 0);
}

/* Trường hợp xấu nhất vẫn vừa bộ đệm gửi 768 byte của web_server.c */
ZTEST(web, test_worst_case_telemetry_fits)
{
	char buf[768];

	memset(g_robot.notice, '\x01', sizeof(g_robot.notice) - 1);
	memset(g_robot.drive_dir, '"', sizeof(g_robot.drive_dir) - 1);
	g_robot.error = -1.0e9f;
	g_robot.correction = -1.0e30f;

	zassert_true(web_telemetry_json(buf, sizeof(buf), &g_robot, "255.255.255.255",
					-127) > 0);
}

/* Sinh số giả ngẫu nhiên cố định để lỗi lặp lại được */
static uint32_t next_random(void)
{
	static uint32_t state = 0x2545F491U;

	state ^= state << 13;
	state ^= state >> 17;
	state ^= state << 5;
	return state;
}

/*
 * Đột biến các lệnh hợp lệ rồi đưa vào parser. Mỗi đầu vào nằm trong bộ đệm
 * đúng kích thước nên đọc lố sẽ bị AddressSanitizer bắt.
 */
ZTEST(web, test_mutated_input_is_safe)
{
	static const char *const seeds[] = {
		"{\"cmd\":\"goto\",\"id\":3,\"code\":\"LRS0\"}",
		"{\"cmd\":\"config\",\"kp\":1.5e2,\"ki\":-0.1,\"base\":120}",
		"{\"cmd\":\"drive\",\"dir\":\"a\\u00e9\\n\",\"x\":[{},[true,null]]}",
		"{\"1\":\"S0\",\"2\":\"LR0\"}",
	};
	static const char alphabet[] = "{}[]\":,\\u0123456789.eE+-tfn \x01";

	for (int round = 0; round < 40000; round++) {
		char work[96];
		const char *seed = seeds[next_random() % ARRAY_SIZE(seeds)];
		size_t len = strlen(seed);
		struct web_reply reply;
		const char *error = NULL;
		struct command c;

		memcpy(work, seed, len);
		for (uint32_t i = next_random() % 6U; i > 0U; i--) {
			work[next_random() % len] =
				alphabet[next_random() % (sizeof(alphabet) - 1)];
		}
		if (next_random() % 4U == 0U) {
			len = next_random() % (len + 1U);
		}

		char *exact = malloc(len == 0U ? 1U : len);

		zassert_not_null(exact);
		memcpy(exact, work, len);
		web_handle_command(exact, len, &reply);
		(void)destinations_save_json(exact, len, &error);
		free(exact);

		while (k_msgq_get(&g_cmd_queue, &c, K_NO_WAIT) == 0) {
			zassert_not_null(memchr(c.text, '\0', sizeof(c.text)));
		}
	}
}
```
